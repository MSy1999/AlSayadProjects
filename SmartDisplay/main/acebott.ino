// generated by Block
#include <Arduino.h>
#include <ACB_LCD1602.h>
#include <ACB_hd44780.h>
#include <Wire.h>
#include <ACB_OLED.h>
#include <U8g2lib.h>
#include <ACB_Adafruit_SSD1306.h>
#include <ACB_WIFI.h>
#include <WebServer.h>
#include <ACB_CAR_ARM.h>
#include <ACB_ESP32Servo.h>

String message;
String move;
ACB_LCD1602 lcd_;
ACB_OLED oled_;
ACB_WIFI wifi;
WebServer web_server(80);
ACB_CAR_ARM arm_car;

void spider_callback_bMHUGcR3XtbSGyr() {
  message = "<html>";
  message = String(message) + String("<style> body {-webkit-user-select: none; -khtml-user-select: none;-moz-user-select: none;-ms-user-select: none;user-select: none;}</style><body>");
  message = String(message) + String("<center><h1>moveCar control</h1></center>");
  message = String(message) + String("<center>");
  message = String(message) + String("<button onmousedown=\"moveCar(\'tl\')\" onmouseup=\"moveCar(\'s\')\" ontouchstart=\"moveCar(\'tl\')\" ontouchend=\"moveCar(\'s\')\" style=\"width:200px;height:250px\">Trun left</button>");
  message = String(message) + String("<button onmousedown=\"moveCar(\'f\')\" onmouseup=\"moveCar(\'s\')\" ontouchstart=\"moveCar(\'f\')\" ontouchend=\"moveCar(\'s\')\" style=\"width:200px;height:250px\">Forward</button>");
  message = String(message) + String("<button onmousedown=\"moveCar(\'tr\')\" onmouseup=\"moveCar(\'s\')\" ontouchstart=\"moveCar(\'tr\')\" ontouchend=\"moveCar(\'s\')\" style=\"width:200px;height:250px\">Trun Right</button>");
  message = String(message) + String("</center><center>");
  message = String(message) + String("<button onmousedown=\"moveCar(\'l\')\" onmouseup=\"moveCar(\'s\')\" ontouchstart=\"moveCar(\'l\')\" ontouchend=\"moveCar(\'s\')\" style=\"width:200px;height:250px\">Left</button>");
  message = String(message) + String("<button onmousedown=\"moveCar(\'b\')\" onmouseup=\"moveCar(\'s\')\" ontouchstart=\"moveCar(\'b\')\" ontouchend=\"moveCar(\'s\')\" style=\"width:200px;height:250px\">Backward</button>");
  message = String(message) + String("<button onmousedown=\"moveCar(\'r\')\" onmouseup=\"moveCar(\'s\')\" ontouchstart=\"moveCar(\'r\')\" ontouchend=\"moveCar(\'s\')\" style=\"width:200px;height:250px\">Right</button>");
  message = String(message) + String("</center>");
  message = String(message) + String("<script>");
  message = String(message) + String("function moveCar(move) {");
  message = String(message) + String("  fetch(\'/Car?move=\' + move);");
  message = String(message) + String("}");
  message = String(message) + String("</script>");
  message = String(message) + String("</body></html>");
  web_server.send(200,"text/html",message);
}

void spider_callback_jTb58cO5Ad1v2vhqF() {
  move = (web_server.arg("move"));
  Serial.println(move);
  if (move == "f") {
    arm_car.Vehicle_Move(163,100);
  }
  if (move == "b") {
  }
  if (move == "l") {
  }
  if (move == "r") {
  }
  web_server.send(200,"text/plain","OK");
}

void setup() {
  lcd_.init();
  oled_.init();
  Serial.begin(115200);
  arm_car.Car_init(2);
// Set the variable to store the transmitted data and set the data type to string
  lcd_.displayChar(0,0,"Hi");
  oled_.setChar(0,0,"Hi");
  // Set Wi-Fi name and password
  wifi.initAP("ESP32-Car","12345678",1);
  // Setting the Server Port
  web_server.begin();
  Serial.print((wifi.staIP()));
  // Generate web pages to send data to control smart cars
  web_server.on("/",spider_callback_bMHUGcR3XtbSGyr);
  web_server.on("/Car",spider_callback_jTb58cO5Ad1v2vhqF);
}

void loop() {
  repeat();
}

void repeat() {
  web_server.handleClient();

}