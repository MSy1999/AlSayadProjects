## MeasurementESP/main/Kconfig.projbuild
```kconfig
menu "MeasurementESP sender"
config AS_SENDER_WIFI_SSID
    string "Display Wi-Fi SSID"
    default "AlSayad-Room"
config AS_SENDER_WIFI_PASSWORD
    string "Display WPA2 password (8-63 bytes)"
    default "AlSayadRoom"
config AS_SENDER_DEVICE_ID
    string "Protocol device ID (1-32 bytes)"
    default "measurement-01"
config AS_SENDER_URL
    string "Display HTTP endpoint"
    default "http://192.168.4.1/api/v1/measurements"
config AS_SENDER_PERIOD_MS
    int "Sampling interval (ms)"
    range 100 60000
    default 2000
config AS_SENDER_HTTP_TIMEOUT_MS
    int "HTTP socket timeout (ms)"
    range 100 30000
    default 3000
config AS_SENDER_SIMULATED
    bool "Generate explicitly marked synthetic test readings"
    default n
    help
        Generates 23.4 C, 56.7 percent humidity and zero percent brightness.
        Every frame carries simulated=true. Disabled means unconfigured sensors
        report unavailable; it never substitutes synthetic values automatically.
menu "DevKitC V4 sensor hardware"
    depends on IDF_TARGET_ESP32
config AS_SENDER_DHT_ENABLED
    bool "KY-015 / DHT11 on GPIO27"
    default y
    help
        Requires 3.3 V supply and DATA pull-up to 3.3 V.
        Physical transactions are spaced by at least two seconds.
config AS_SENDER_DHT_GPIO_CAPTURE
    bool "Use GPIO timing capture instead of RMT for DHT11"
    depends on AS_SENDER_DHT_ENABLED
    default y
    help
        Use this to diagnose RMT receive-completion timeouts. Captures one fresh
        DHT transaction; masks interrupts on the acquisition core for at most
        8 ms. Disable to compare with the original RMT backend.
config AS_SENDER_LIGHT_ENABLED
    bool "KY-018 on GPIO34 / ADC1 channel 6"
    default y
    help
        Requires the documented external 10k/10k divider.
        The 100nF ADC-to-ground capacitor is optional noise filtering.
        Uncalibrated light reports unavailable while logging raw ADC averages.
config AS_SENDER_LIGHT_CALIBRATED
    bool "Enable measured dark/bright calibration"
    depends on AS_SENDER_LIGHT_ENABLED
    default n
    help
        Enable only after measuring endpoints on the complete assembled circuit.
        The defaults below are placeholders and are not measured calibration.
config AS_SENDER_LIGHT_DARK_RAW
    int "Measured dark raw ADC endpoint"
    depends on AS_SENDER_LIGHT_CALIBRATED
    range 0 4095
    default 0
config AS_SENDER_LIGHT_BRIGHT_RAW
    int "Measured bright raw ADC endpoint"
    depends on AS_SENDER_LIGHT_CALIBRATED
    range 0 4095
    default 4095
endmenu
endmenu
```

## SmartDisplay/main/Kconfig.projbuild
```kconfig
menu "AlSayad Room Monitor"
    config AS_ROOM_AP_SSID
        string "Display Wi-Fi AP name"
        default "AlSayad-Room"
    config AS_ROOM_AP_PASSWORD
        string "Display Wi-Fi AP password (8..63 bytes)"
        default "AlSayadRoom"
    config AS_ROOM_DEVICE_ID
        string "Accepted measurement device identifier (1..32 bytes)"
        default "measurement-01"
    config AS_ROOM_SD_ENABLED
        bool "Probe SD storage (requires non-conflicting hardware allocation)"
        default y
        help
            Current CYD LCD/touch reserves SPI2 and SPI3. This is reported as
            unsupported and uses RAM history; no live bus is remapped.
    config AS_ROOM_SD_HOST
        int "SD SPI host number"
        range 1 2
        default 2
    config AS_ROOM_SD_MOSI
        int "SD MOSI GPIO"
        default 23
    config AS_ROOM_SD_MISO
        int "SD MISO GPIO"
        default 19
    config AS_ROOM_SD_SCLK
        int "SD SCLK GPIO"
        default 18
    config AS_ROOM_SD_CS
        int "SD CS GPIO"
        default 5
    config AS_ROOM_SD_BUDGET_MIB
        int "SD history recording budget (MiB)"
        range 1 1024
        default 32
endmenu
```

## SmartDisplay/sdkconfig.defaults
```kconfig
CONFIG_IDF_TARGET="esp32"
CONFIG_ESPTOOLPY_FLASHSIZE_4MB=y
CONFIG_LV_COLOR_DEPTH_16=y
# CONFIG_XPT2046_CONVERT_ADC_TO_COORDS is not set
# CONFIG_XPT2046_INTERRUPT_MODE is not set
# CONFIG_LV_BUILD_EXAMPLES is not set
# CONFIG_LV_BUILD_DEMOS is not set
# CONFIG_SPIRAM is not set

CONFIG_LV_USE_BIDI=y

CONFIG_LV_USE_ARABIC_PERSIAN_CHARS=y

CONFIG_LV_USE_CHART=y
CONFIG_PARTITION_TABLE_CUSTOM=y
CONFIG_PARTITION_TABLE_CUSTOM_FILENAME="partitions.csv"
CONFIG_PARTITION_TABLE_FILENAME="partitions.csv"
CONFIG_CJSON_NESTING_LIMIT=16
CONFIG_ESP_MAIN_TASK_STACK_SIZE=6144

CONFIG_LV_USE_FONT_COMPRESSED=y
```

## miniDrone/controller/esp32_remote/main/Kconfig.projbuild
```kconfig
menu "AlSayad remote"
config AS_DRONE_MAC
    string "Drone STA MAC"
    default "00:00:00:00:00:00"
config AS_PAIR_KEY
    string "Same unique 32-hex key configured on drone"
    default "00000000000000000000000000000000"
endmenu
```

## miniDrone/main/Kconfig.projbuild
```kconfig
menu "AlSayad MiniDrone"
config AS_ENABLE_MOTORS
    bool "Enable two-wire BRUSHED motor MOSFET outputs (hardware verified only)"
    default n
config AS_ESPNOW
    bool "Use paired ESP-NOW controller instead of phone"
    default n
config AS_REMOTE_MAC
    string "Paired controller STA MAC (ESP-NOW mode)"
    default "00:00:00:00:00:00"
config AS_ESPNOW_KEY
    string "ESP-NOW key: exactly 32 hex digits, unique per pair"
    default "00000000000000000000000000000000"
config AS_WIFI_PASSWORD
    string "Drone Wi-Fi password (change before use)"
    default "AlSayad-change-me"
endmenu
```

## miniDrone/sdkconfig.defaults
```kconfig
CONFIG_IDF_TARGET="esp32c3"
CONFIG_FREERTOS_HZ=1000
CONFIG_ESP_CONSOLE_USB_SERIAL_JTAG=y
CONFIG_HTTPD_WS_SUPPORT=y
```
